#include "main.h"
#include "dac.h"

// Top four bits the DAC expects:. Turned on, 1x gain without buffering
#define MCP4921_CTRL_ACTIVE_GAIN1  (0x3 << 12)

static void dac_cs_high(void) {
	DAC_CS_PORT->BSRR = DAC_CS_PIN;
	DAC_CS_PORT->OTYPER &= ~(1 << 6);
}

static void dac_cs_low(void) {
	DAC_CS_PORT->BSRR = (uint32_t) DAC_CS_PIN << 16;

}

// One 16-bit SPI1 frame. CS must already be low if framed by DAC_write.
static void dac_spi_tx16(uint16_t halfword) {
	while ((SPI1->SR & SPI_SR_TXE) == 0) {
	}
	// Shove the 16-bit word into SPI
	*(__IO uint16_t*) &SPI1->DR = halfword; // NOTE: This was generated by 3160 agent
	while ((SPI1->SR & SPI_SR_RXNE) == 0) {
	}
	// Have to read DR once so the peripheral finishes cleanly
	(void) *(__IO uint16_t*) &SPI1->DR; // NOTE: This was generated by 3160 agent
	while ((SPI1->SR & SPI_SR_BSY) != 0) {
	}
}

// Sets up SPI and CS so we can talk to the DAC
void DAC_init(void) {

	RCC->AHB2ENR |= RCC_AHB2ENR_GPIOAEN | RCC_AHB2ENR_GPIOBEN;
	RCC->APB2ENR |= RCC_APB2ENR_SPI1EN;

	// PB6 output, idle is high
	DAC_CS_PORT->MODER &= ~GPIO_MODER_MODE6;
	DAC_CS_PORT->MODER |= (GPIO_MODER_MODE0_0 << (6 * 2)); /* general output */
	DAC_CS_PORT->OTYPER &= ~(1 << 6);
	dac_cs_high();

	// PA5 = SPI1_SCK, PA7 = SPI1_MOSI, AF5
	GPIOA->MODER &= ~(GPIO_MODER_MODE5 | GPIO_MODER_MODE7);
	GPIOA->MODER |= ((2 << GPIO_MODER_MODE5_Pos) | (2 << GPIO_MODER_MODE7_Pos));
	GPIOA->OTYPER &= ~(GPIO_OTYPER_OT5 | GPIO_OTYPER_OT7);
	GPIOA->OSPEEDR |= (GPIO_OSPEEDR_OSPEED5 | GPIO_OSPEEDR_OSPEED7);
	GPIOA->PUPDR &= ~(GPIO_PUPDR_PUPD5 | GPIO_PUPDR_PUPD7);
	GPIOA->AFR[0] &= ~((0xF << GPIO_AFRL_AFSEL5_Pos)
			| (0xF << GPIO_AFRL_AFSEL7_Pos));
	GPIOA->AFR[0] |= ((0x5 << GPIO_AFRL_AFSEL5_Pos)
			| (0x5 << GPIO_AFRL_AFSEL7_Pos)); // AF5

	// SPI1: disable fist, then configure, and enable
	SPI1->CR1 &= ~SPI_CR1_SPE;
	SPI1->CR1 = SPI_CR1_MSTR | SPI_CR1_SSM | SPI_CR1_SSI
			| (0x5 << SPI_CR1_BR_Pos);

	/* Mode 0: CPOL=0, CPHA=0 (default with bits cleared) */
	SPI1->CR2 = (0xF << SPI_CR2_DS_Pos);
	SPI1->CR1 |= SPI_CR1_SPE;
}

// Convert mV into the number DAC_write wants
uint16_t DAC_volt_conv(uint16_t mv) {
	if (mv >= DAC_VREF_MV) {
		return DAC_CODE_MAX;
	}
	return (uint16_t) (((uint32_t) mv * DAC_CODE_MAX) / DAC_VREF_MV);
}

// Sends a 12-bit value; we handle the DAC header bits
void DAC_write(uint16_t code12) {
	uint16_t word = MCP4921_CTRL_ACTIVE_GAIN1 | (code12 & 0x0FFF);
	dac_cs_low();
	dac_spi_tx16(word);
	dac_cs_high();
}
